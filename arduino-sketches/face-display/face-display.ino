/*
  face-display: 32x32 RGB matrix that swaps facial expressions over serial.
  target board: Arduino Zero (Native USB Port preferred).

  serial protocol (115200 baud, newline-terminated, case-insensitive):
    I  -> idle
    C  -> smug
    S  -> sad
    W  -> win
  unknown bytes are ignored. on boot the matrix shows IDLE.

  bitmaps:
    each face = uint16_t[1024] PROGMEM array (32x32 RGB565, row-major).
    a face whose slot is nullptr falls back to a solid tint colour so the
    serial protocol can be verified before the real art exists.
*/

#include <Adafruit_Protomatter.h>

// ---------- matrix wiring (RGB Matrix Shield default) ----------
uint8_t rgbPins[]  = {2, 3, 4, 5, 6, 7};
uint8_t addrPins[] = {A0, A1, A2, A3};
uint8_t clockPin   = 8;
uint8_t latchPin   = 10;
uint8_t oePin      = 9;

Adafruit_Protomatter matrix(
  32, 4, 1, rgbPins, 4, addrPins,
  clockPin, latchPin, oePin, false);

// ---------- face slots ----------
enum FaceId : uint8_t {
  FACE_IDLE = 0,
  FACE_SMUG,
  FACE_SAD,
  FACE_WIN,
  FACE_COUNT
};

// ===========================================================================
// SMUG  (face_with_tounge_3)
// ===========================================================================
const uint16_t faceSmugBitmap[1024] PROGMEM = {
  0xffff, 0xffff, 0xffff, 0xffff, 0xffff, 0xffff, 0xffdf, 0xffff, 0xffff, 0xffff, 0xffff, 0xffff,
  0xffff, 0xffff, 0xffff, 0xffff, 0xffff, 0xffff, 0xffff, 0xffff, 0xffff, 0xffff, 0xffff, 0xffff,
  0xffff, 0xffdf, 0xffff, 0xffff, 0xffff, 0xffff, 0xffff, 0xffff, 0xffff, 0xffff, 0xffff, 0xffff,
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  0xffff, 0xffff, 0xffff, 0xffff,
};

// ===========================================================================
// SAD  (face_with_tounge_4)
// ===========================================================================
const uint16_t faceSadBitmap[1024] PROGMEM = {
  0xffff, 0xffff, 0xffff, 0xffff, 0xffff, 0xffff, 0xffff, 0xffff, 0xffff, 0xffff, 0xffff, 0xffff,
  0xffff, 0xffff, 0xffff, 0xffff, 0xffff, 0xffff, 0xffff, 0xffff, 0xffff, 0xffff, 0xffff, 0xffff,
  0xffff, 0xffff, 0xffdf, 0xffff, 0xffff, 0xffff, 0xffff, 0xffff, 0xffff, 0xffff, 0xffff, 0xffdf,
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  0xffff, 0xffff, 0xffff, 0xffff,
};

// ===========================================================================
// WIN  (face_with_tounge_5 — colourful tongue-out)
// ===========================================================================
const uint16_t faceWinBitmap[1024] PROGMEM = {
  0xffff, 0xffff, 0xffff, 0xffff, 0xffff, 0xffff, 0xffff, 0xffff, 0xffff, 0xffff, 0xffff, 0xffff,
  0xffff, 0xffff, 0xffff, 0xffdf, 0xffff, 0xffff, 0xffff, 0xffff, 0xffff, 0xffff, 0xffff, 0xffdf,
  0xffff, 0xffff, 0xffff, 0xffff, 0xffff, 0xffff, 0xffff, 0xffdf, 0xffff, 0xffff, 0xffff, 0xffff,
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  0xffff, 0xffff, 0xffff, 0xffff,
};

// ===========================================================================
// IDLE  (idle.jpeg)
// ===========================================================================
const uint16_t faceIdleBitmap[1024] PROGMEM = {
  0xffff, 0xffff, 0xffff, 0xffff, 0xffff, 0xffff, 0xffff, 0xffff, 0xffff, 0xffff, 0xffff, 0xffff,
  0xffff, 0xffff, 0xffff, 0xffdf, 0xffff, 0xffff, 0xffff, 0xffff, 0xffff, 0xffff, 0xffff, 0xffdf,
  0xffff, 0xffff, 0xffff, 0xffff, 0xffff, 0xffff, 0xffff, 0xffdf, 0xffff, 0xffff, 0xffff, 0xffff,
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  0xffff, 0xffff, 0xffff, 0xffff,
};

// ---------- face dispatch table ----------
const uint16_t* FACES[FACE_COUNT] = {
  faceIdleBitmap,   // FACE_IDLE
  faceSmugBitmap,   // FACE_SMUG
  faceSadBitmap,    // FACE_SAD
  faceWinBitmap,    // FACE_WIN
};

// fallback tints used when a face has no bitmap yet.
const uint16_t FACE_TINT[FACE_COUNT] = {
  0xffff,  // IDLE - white
  0xffe0,  // SMUG - yellow
  0x001f,  // SAD  - blue
  0x07e0,  // WIN  - green
};

uint8_t currentFace = 255;

void drawFace(uint8_t id) {
  if (id >= FACE_COUNT) return;
  if (id == currentFace) return;
  currentFace = id;

  const uint16_t* bmp = FACES[id];
  if (bmp == nullptr) {
    matrix.fillScreen(FACE_TINT[id]);
  } else {
    for (int16_t y = 0; y < 32; y++) {
      for (int16_t x = 0; x < 32; x++) {
        uint16_t c = pgm_read_word(&bmp[y * 32 + x]);
        matrix.drawPixel(x, y, c);
      }
    }
  }
  matrix.show();
}

uint8_t commandToFace(char c) {
  switch (c) {
    case 'I': case 'i': return FACE_IDLE;
    case 'C': case 'c': return FACE_SMUG;
    case 'S': case 's': return FACE_SAD;
    case 'W': case 'w': return FACE_WIN;
    default:            return 255;
  }
}

// ---------- arduino lifecycle ----------
void setup() {
  Serial.begin(115200);

  ProtomatterStatus status = matrix.begin();
  if (status != PROTOMATTER_OK) {
    pinMode(LED_BUILTIN, OUTPUT);
    while (true) {
      digitalWrite(LED_BUILTIN, HIGH); delay(100);
      digitalWrite(LED_BUILTIN, LOW);  delay(100);
    }
  }

  matrix.fillScreen(0x0000);
  drawFace(FACE_IDLE);
  Serial.println("face-display ready");
}

void loop() {
  while (Serial.available()) {
    int b = Serial.read();
    if (b < 0) break;
    if (b == '\n' || b == '\r' || b == ' ') continue;

    uint8_t f = commandToFace((char)b);
    if (f != 255) drawFace(f);
  }
}
